## src/modules/automation/Kconfig
```kconfig
menuconfig MODULES_AUTOMATION
	bool "automation"
	default n
	---help---
		Enable support for automation

menuconfig USER_AUTOMATION
	bool "automation running as userspace module"
	default y
	depends on BOARD_PROTECTED && MODULES_AUTOMATION
	---help---
		Put automation in userspace memory

menuconfig MODE_AUTOMATION_VTOL_TAKEOFF
	bool "Include VTOL takeoff mode support"
	default n
	depends on MODULES_AUTOMATION
	---help---
		Add VTOL takeoff mode to enable support for MAV_CMD_NAV_VTOL_TAKEOFF.
		The VTOL takes off in MC mode and transition to FW. The mode ends with
		an infinite loiter

menuconfig NAVIGATOR_ADSB
	bool "Include traffic reporting and avoidance"
	default y
	depends on MODULES_AUTOMATION
	---help---
		Add support for acting on ADSB transponder_report or ADSB_VEHICLE MAVLink messages.
		Actions are warnings, Loiter, Land and RTL without climb.

menuconfig NUM_MISSION_ITMES_SUPPORTED
	int "Maximum number of mission items"
	default 500
	depends on MODULES_AUTOMATION
	---help---
		This limit always applies if mission items are stored on the SD card or in RAM. It should be set
		adequately per boards such that if the items are stored in RAM they still fit the available memory.
		The runtime parameter to configure the storage option is `SYS_DM_BACKEND`.
```

## src/modules/command_processor/Kconfig
```kconfig
menuconfig MODULES_COMMAND_PROCESSOR
	bool "command_processor"
	default n
	---help---
		Enable support for command_processor module

		Command Processor handles vehicle_command_s messages and dispatches them
		to vehicle-specific command handlers. It provides:
		- Vehicle-type specific command handling
		- Mode change request publishing (mode_change_request)
		- Automation task publishing (automation_task)
		- Command acknowledgment handling
```

## src/modules/mode_manager/Kconfig
```kconfig
menuconfig MODULES_MODE_MANAGER
	bool "mode_manager"
	default n
	---help---
		Enable support for mode_manager

menuconfig USER_MODE_MANAGER
	bool "mode_manager running as userspace module"
	default y
	depends on BOARD_PROTECTED && MODULES_MODE_MANAGER
	---help---
		Put mode_manager in userspace memory
```

## src/modules/multicopter_throw_launch/Kconfig
```kconfig
menuconfig MODULES_MC_THROW_LAUNCH
	bool "multicopter_throw_launch"
	default n
	---help---
		Enable support for multicopter throw launch

menuconfig USER_MC_THROW_LAUNCH
	bool "multicopter_throw_launch running as userspace module"
	default y
	depends on BOARD_PROTECTED && MODULES_MC_THROW_LAUNCH
	---help---
		Put multicopter_throw_launch in userspace memory
```

## src/modules/system_manager/Kconfig
```kconfig
menuconfig MODULES_SYSTEM_MANAGER
	bool "system_manager"
	default n
	---help---
		Enable support for system_manager

menuconfig USER_SYSTEM_MANAGER
	bool "system_manager running as userspace module"
	default y
	depends on BOARD_PROTECTED && MODULES_SYSTEM_MANAGER
	---help---
		Put system_manager in userspace memory
```
