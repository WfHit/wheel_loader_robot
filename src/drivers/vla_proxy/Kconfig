## src/drivers/vla_proxy/Kconfig
```kconfig
menuconfig DRIVERS_VLA_PROXY
	bool "VLA Proxy driver"
	default n
	help
	  Enable support for VLA (Vision-Language-Action) Proxy driver.

	  This driver provides communication with VLA models via UART interface,
	  allowing autonomous wheel loader bucket control with 6DOF trajectory
	  commands. The driver sends robot status to the VLA model and receives
	  trajectory setpoints for bucket positioning.
```

## src/modules/operation_mode_manager/Kconfig
```kconfig
menuconfig MODULES_OPERATION_MODE_MANAGER
	bool "operation_mode_manager"
	default n
	---help---
		Enable support for Operation Mode Manager module.

		This module manages operation modes for wheel loader robots:
		- Manual mode: Direct RC control of chassis and bucket
		- VLA mode: Vision-Language-Action autonomous trajectory following

		The module handles mode switching, trajectory decomposition,
		safety monitoring, and coordinated motion control.
```

## src/modules/safety_manager/Kconfig
```kconfig
menuconfig MODULES_SAFETY_MANAGER
	bool "safety_manager"
	default n
	---help---
		Enable support for safety_manager.

		The safety manager monitors critical wheel loader systems and publishes
		safety status including speed monitoring, steering angle monitoring,
		vehicle stability monitoring, H-bridge system health, bucket system
		health, and communication timeout detection.
```

## src/modules/trajectory_followers/Kconfig
```kconfig
menuconfig MODULES_TRAJECTORY_FOLLOWERS
	bool "trajectory_followers"
	default n
	---help---
		Enable support for trajectory following modules

if MODULES_TRAJECTORY_FOLLOWERS

config TRAJECTORY_FOLLOWERS_CHASSIS_TRAJECTORY_FOLLOWER
	bool "chassis_trajectory_follower"
	default y
	depends on MODULES_TRAJECTORY_FOLLOWERS
	---help---
		Enable the chassis trajectory follower module.
		This module implements Model Predictive Control (MPC) for chassis motion,
		providing trajectory following capabilities for the wheel loader chassis.

config TRAJECTORY_FOLLOWERS_END_EFFECTOR_TRAJECTORY_FOLLOWER
	bool "end_effector_trajectory_follower"
	default y
	depends on MODULES_TRAJECTORY_FOLLOWERS
	---help---
		Enable the end effector trajectory follower module.
		This module implements 6-DOF PID control for end effector motion,
		providing trajectory following capabilities for the wheel loader end effector assembly.

endif # MODULES_TRAJECTORY_FOLLOWERS
```

## src/modules/trajectory_followers/chassis_trajectory_follower/Kconfig
```kconfig
menuconfig TRAJECTORY_FOLLOWERS_CHASSIS_TRAJECTORY_FOLLOWER
	bool "chassis_trajectory_follower"
	default y
	depends on MODULES_TRAJECTORY_FOLLOWERSig CHASSIS_TRAJECTORY_FOLLOWER
	bool "chassis_trajectory_follower"
	default y
	depends on MODULES_TRAJECTORY_FOLLOWERS
	---help---
		Enable the chassis trajectory follower module.

		This module implements Model Predictive Control (MPC) for chassis motion control.
		It provides trajectory following capabilities for the wheel loader chassis,
		including:
		- MPC-based trajectory tracking
		- Velocity and acceleration constraints
		- Emergency stop handling
		- Coordination with bucket controller
		- Real-time trajectory optimization
```

## src/modules/trajectory_followers/end_effector_trajectory_follower/Kconfig
```kconfig
menuconfig TRAJECTORY_FOLLOWERS_END_EFFECTOR_TRAJECTORY_FOLLOWER
	bool "end_effector_trajectory_follower"
	default y
	depends on MODULES_TRAJECTORY_FOLLOWERS
	---help---
		Enable the end effector trajectory follower module.

		This module implements 6-DOF PID control for end effector motion control.
		It provides trajectory following capabilities for the wheel loader end effector assembly,
		including:
		- 6-DOF PID controllers (position + orientation)
		- Joint limit enforcement
		- Gravity compensation
		- Load handling compensation
		- Safety constraint monitoring
```
